## Kconfig
```kconfig
# Sensor data simulator
#
# Copyright (c) 2019 Nordic Semiconductor
#
# SPDX-License-Identifier: LicenseRef-Nordic-5-Clause
#

menuconfig PMW3610_ALT
  bool "PMW3610 mouse optical sensor"
  select SPI
  depends on INPUT
  depends on DT_HAS_PIXART_PMW3610_ALT_ENABLED
  help
      Enable PMW3610 mouse optical sensor.

if PMW3610_ALT

config INPUT_PMW3610_INIT_PRIORITY
    int "PMW3610 initialization priority"
    default INPUT_INIT_PRIORITY

config PMW3610_ALT_SWAP_XY
  bool "Swap the X/Y axis of PMW3610 sensor"

config PMW3610_ALT_INVERT_X
  bool "Invert the X axis of PMW3610 sensor"

config PMW3610_ALT_INVERT_Y
  bool "Invert the Y axis of PMW3610 sensor"

config PMW3610_ALT_INIT_POWER_UP_EXTRA_DELAY_MS
  int "Extra power up init delay (ms)"
  default 0
  help
    Default minimum init power up delay is 10ms.
    Use this config to postpone init power up sequence if needs longer bootup time.

config PMW3610_ALT_REPORT_INTERVAL_MIN
	int "PMW3610's default minimum report rate"
	default 0
	help
	  Default minimum report interval in milliseconds.
		Slow down input reporting for hid queue over the air.
		Turn value down to 8ms to get sharp response if use with USB only.

config PMW3610_ALT_SMART_ALGORITHM
  bool "Enable an algorithm of PMW3610 to enhance surface coverage"
  default y
  help
    Enable the integration of the smart algorithm as the datasheet implementation.
    The algorithm is used to extend the tracking acrocss a wider range of surfaces
    such as graniles and tiles.

config PMW3610_ALT_RUN_DOWNSHIFT_TIME_MS
    int "PMW3610's default RUN mode downshift time"
    default 128
    range 13 3264
    help
      Default RUN mode downshift down time in milliseconds.
      Time after which sensor goes from RUN to REST1 mode.

config PMW3610_ALT_REST1_DOWNSHIFT_TIME_MS
    int "PMW3610's default REST1 mode downshift time"
    default 5000
    help
      Default REST1 mode downshift down time in milliseconds.
      Time after which sensor goes from REST1 to REST2 mode.

config PMW3610_ALT_REST2_DOWNSHIFT_TIME_MS
    int "PMW3610's default REST2 mode downshift time"
    default 17000
    help
      Default REST2 mode downshift down time in milliseconds.
      Time after which sensor goes from REST2 to REST3 mode.

config PMW3610_ALT_REST1_SAMPLE_TIME_MS
    int "PMW3610's sample time in REST1 stage"
    default 40
    # range 10 2550
    help
      Default REST1 mode sample period in millisecond

config PMW3610_ALT_REST2_SAMPLE_TIME_MS
    int "PMW3610's sample time in REST2 stage"
    default 100
    # range 10 2550
    help
      Default REST2 mode sample period in millisecond.

config PMW3610_ALT_REST3_SAMPLE_TIME_MS
    int "PMW3610's sample time in REST3 stage"
    default 500
    # range 10 2550
    help
      Default REST2 mode sample period in millisecond.

config PMW3610_ALT_FRAME_CAPTURE
  bool "Capture raw 22x22 pixel frames from PMW3610"
  default n
  help
    Capture a full 484-byte pixel frame (22x22 array, datasheet p.17)
    after each motion handling and keep the latest frame in a
    double-buffered, mutex-protected array.

config PMW3610_ALT_FRAME_CAPTURE_SKIP_REPORT_ALWAYS
  bool "Always skip motion x/y reports and only capture frames"
  default n
  depends on PMW3610_ALT_FRAME_CAPTURE
  help
    Skip the motion x/y report path unconditionally so only frame
    capture runs. Cursor movement stops working. Takes precedence over
    PMW3610_ALT_FRAME_CAPTURE_SKIP_REPORT_WHEN_CAPTURE.

config PMW3610_ALT_FRAME_CAPTURE_SKIP_REPORT_WHEN_CAPTURE
  bool "Skip motion x/y reports only while frame capture is running"
  default n
  depends on PMW3610_ALT_FRAME_CAPTURE
  help
    Skip the motion x/y report path only while the frame capture
    scheduler is running (the host is requesting frames). Motion
    reporting resumes once capture stops.

config PMW3610_ALT_FRAME_CAPTURE_PERIOD_MS
  int "Periodic frame capture interval in ms"
  default 35
  range 10 1000
  depends on PMW3610_ALT_FRAME_CAPTURE
  help
    Interval in milliseconds between self-retriggered frame captures
    while the host requests frames (streaming starts on a host get-frame
    request and stops after PMW3610_ALT_FRAME_CAPTURE_IDLE_TIMEOUT_MS
    without one).
    Minimum is PMW3610_FRAME_GRAB_DELAY_MS (10ms FG_EN wait per capture).
    Note: a value > 0 keeps the sensor/system busy and awake while streaming.

config PMW3610_ALT_FRAME_CAPTURE_IDLE_TIMEOUT_MS
  int "Capture scheduler idle timeout in ms"
  default 1500
  depends on PMW3610_ALT_FRAME_CAPTURE
  help
    Stop the periodic capture scheduler after this long without a host
    get-frame request. The scheduler starts again on the next request.

config PMW3610_ALT_FRAME_CAPTURE_HID_AUX
  bool "Send captured frames to the host as a HID input report"
  default y
  depends on PMW3610_ALT_FRAME_CAPTURE
  depends on ZMK_USB
  help
    Sends the captured frame to the host as a vendor HID input report
    (report id 0x01, usage page 0xFF0C) split into 9 chunks of 56 bytes.
    Requires CONFIG_USB_HID_DEVICE_COUNT >= 2 (and a matching
    CONFIG_HID_INTERRUPT_EP_MPS, e.g. 64) so this module can claim the
    HID_<n> device. Do not enable another vendor HID module on the
    same HID device binding number.

config PMW3610_ALT_FRAME_CAPTURE_HID_BINDING_NUM
  int "Number to append to 'HID_' as parameter of device_get_binding() in pmw3610_hid.c"
  default 1
  depends on PMW3610_ALT_FRAME_CAPTURE

module = PMW3610_ALT
module-str = PMW3610_ALT
source "${ZEPHYR_BASE}/subsys/logging/Kconfig.template.log_config"

endif #PMW3610_ALT
```
